## config/boards/shields/Pyuron/Kconfig.defconfig
```kconfig
if SHIELD_PYURON_R

config ZMK_KEYBOARD_NAME
    default "Pyuron_R"

config ZMK_SPLIT
    default y
    
config ZMK_POINTING
    default y

config PAW3222
    default y
config ZMK_SPLIT_ROLE_CENTRAL
    default y

endif

if SHIELD_PYURON_L

config ZMK_KEYBOARD_NAME
    default "Pyuron_L"

config ZMK_SPLIT
    default y
    
config ZMK_POINTING
    default y

config PAW3222
    default y

endif
```

## config/west.yml
```yaml
manifest:
  remotes:
    - name: zmkfirmware 
      url-base: https://github.com/zmkfirmware
    - name: MeowCatpawkittie
      url-base: https://github.com/MeowCatpawkittie
    - name: caksoylar
      url-base: https://github.com/caksoylar  
    - name: badjeff
      url-base: https://github.com/badjeff
  projects:
    - name: zmk
      remote: zmkfirmware
      revision: 354cff9
      import: app/west.yml
    - name: zmk-pmw3610-driver
      remote: badjeff
      revision: main
    - name: zmk-rgbled-widget
      remote: MeowCatpawkittie
      revision: main
  self:
    path: config
```
